## src/drivers/haitai_uart/Kconfig
```kconfig
menuconfig DRIVERS_HAITAI_UART
	bool "haitai_uart"
	default n
	---help---
		Enable support for haitai_uart driver skeleton (write_test/read_test exports)
```

## src/modules/blackbox_data/Kconfig
```kconfig
menuconfig MODULES_BLACKBOX_DATA
	bool "blackbox_data"
	default n
	---help---
		Enable support for blackbox_data

menuconfig USER_BLACKBOX_DATA
	bool "blackbox_data running as userspace module"
	default n
	depends on BOARD_PROTECTED && MODULES_BLACKBOX_DATA
	---help---
		Put blackbox_data in userspace memory
```

## src/modules/blackbox_param/Kconfig
```kconfig
menuconfig MODULES_BLACKBOX_PARAM
	bool "blackbox_param"
	default n
	---help---
		Enable support for blackbox_param

menuconfig USER_BLACKBOX_PARAM
	bool "blackbox_param running as userspace module"
	default n
	depends on BOARD_PROTECTED && MODULES_BLACKBOX_PARAM
	---help---
		Put blackbox_param in userspace memory
```

## src/modules/head_pitch_controller/Kconfig
```kconfig
menuconfig MODULES_HEAD_PITCH_CONTROLLER
	bool "head_pitch_controller"
	default n
	---help---
		Enable support for head_pitch_controller

menuconfig USER_HEAD_PITCH_CONTROLLER
	bool "head_pitch_controller running as userspace module"
	default n
	depends on BOARD_PROTECTED && MODULES_HEAD_PITCH_CONTROLLER
	---help---
		Put head_pitch_controller in userspace memory
```
